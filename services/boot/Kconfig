## services/boot/Kconfig
```kconfig
config SERVICE_BOOT
	bool "Enable booting"
	default y
	select SERVICE_OPENSBI
        select SERVICE_DDR
	help
                This feature enables support for bootstrapping the U54 application harts. This
                is enabled by default.

menu "Boot Service"
    visible if SERVICE_BOOT

config SERVICE_BOOT_SPI_FLASH_OFFSET
    hex "Copy payload from SPI FLASH at offset"
    default  0x400
    depends on SERVICE_SPI
    help
                This feature specifies the offset in SPI Flash where a boot image is stored.

config SERVICE_BOOT_USE_PAYLOAD
    bool "Use Payload Boot"
    default  n
    depends on SERVICE_BOOT
    help
                This feature enables booting a directly contained payload.

config SERVICE_BOOT_USE_PAYLOAD_IN_FABRIC
    bool "Use Payload in Fabric"
    default  n
    depends on SERVICE_BOOT_USE_PAYLOAD
    help
            This feature enables booting a payload contained in the fabric.

config SERVICE_BOOT_USE_PAYLOAD_IN_FABRIC_ADDRESS
    hex "Payload Fabric Address"
    default  0x400
    depends on SERVICE_BOOT_USE_PAYLOAD_IN_FABRIC
    help
            This feature specifies the address for a payload contained in the fabric.

config SERVICE_BOOT_CUSTOM_FLOW
    bool "Use Custom Boot Flow"
    default  n
    depends on SERVICE_BOOT
    help
                This feature enables custom booting flow where all HARTs
                will jump to same entry point in M-mode.

config SERVICE_BOOT_DDR_TARGET_ADDR
	hex "Target Base address for BOOT to DDR copy"
	default 0x103FC00000
	depends on SERVICE_BOOT
	help
                This feature specifies a scratch address for EMMC/QSPI decompression

config SERVICE_BOOT_REDUNDANT
	bool "Redundant striped boot image (storage independent)"
	default n
	depends on SERVICE_BOOT
	help
		This feature enables a storage-independent redundant boot
		image reader that replaces the normal single boot image
		lookup.  Storage holds three images - the HSS uboot boot
		image, a Linux kernel Image and a device tree blob - each
		stored as three redundant copies, for nine striped chunks in
		total.  The chunks are interleaved by image (uboot, kernel,
		dtb, uboot, kernel, dtb, ...) and use precalculated constant
		offsets (see services/boot/hss_boot_rsimage.h).
		Every chunk carries its own header and CRC32, and all copies
		of an image are checked, falling back to the next copy on a
		mismatch.

		The regular per-storage boot code is used when this option is
		off.

		If you do not know what to do here, say N.

choice
	prompt "Storage for the redundant striped boot image"
	depends on SERVICE_BOOT_REDUNDANT
	default SERVICE_BOOT_REDUNDANT_QSPI
	help
		Compile-time (include) selection of which storage backend
		uses the redundant striped layout instead of its normal boot
		image lookup.  The chunk layout is identical for every
		storage; only the backend that performs the reads differs.

config SERVICE_BOOT_REDUNDANT_QSPI
	bool "QSPI"
	depends on SERVICE_QSPI
	help
		Apply the redundant striped layout to the QSPI boot storage.

config SERVICE_BOOT_REDUNDANT_MMC
	bool "MMC (SD/eMMC)"
	depends on SERVICE_MMC
	help
		Apply the redundant striped layout to the MMC boot storage.
		The chunk offsets are byte offsets into the MMC device, so a
		dedicated card/region is expected.

endchoice

config SERVICE_BOOT_MMC_USE_GPT
    bool "Use GPT with MMC"
    default SERVICE_BOOT && SERVICE_MMC && y
	depends on SERVICE_MMC
	help
		If CONFIG_SERVICE_MMC is enabled, then for MMC boots this option enables
                parsing of a GUID Partition Table (GPT) in search of the boot image starting
                sector..

config SERVICE_BOOT_SNVM
    bool "Boot from sNVM"
    default n
    depends on SERVICE_BOOT
    help
                This feature enables reading an HSS payload from Secure NVM (sNVM)
                pages at boot time. The payload is assembled from sequential sNVM
                pages into an L2-LIM staging area, then processed by the standard
                HSS boot service. Each sNVM page holds 252 bytes (non-authenticated).

config SERVICE_BOOT_SNVM_START_PAGE
    int "sNVM start page"
    default 0
    range 0 220
    depends on SERVICE_BOOT_SNVM
    help
                First sNVM page (module index) where the HSS payload is stored.
                Valid range: 0-220.

config SERVICE_BOOT_SNVM_PAGE_COUNT
    int "sNVM page count"
    default 221
    range 1 221
    depends on SERVICE_BOOT_SNVM
    help
                Number of sNVM pages to read. Maximum 221 pages (55,692 bytes
                at 252 bytes per page for non-authenticated format).

config SERVICE_BOOT_SNVM_STAGING_ADDR
    hex "L2-LIM staging address for sNVM payload"
    default 0x08100000
    depends on SERVICE_BOOT_SNVM
    help
                Address in L2-LIM where sNVM pages are assembled into a
                contiguous HSS payload image before boot processing.
                Must not overlap with HSS resident area or wolfBoot target.

config SERVICE_BOOT_SNVM_MAX_SIZE
    hex "Maximum sNVM payload size (bytes)"
    default 0xE000
    depends on SERVICE_BOOT_SNVM
    help
                Maximum size of sNVM payload. Used as YMODEM receive buffer
                size when DDR is disabled. 221 pages * 252 bytes = 55,692
                bytes. Default 0xE000 (57,344 bytes) provides headroom.

endmenu
```
